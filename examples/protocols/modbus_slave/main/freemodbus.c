/* Modbus Example

   This example code is in the Public Domain (or CC0 licensed, at your option.)

   Unless required by applicable law or agreed to in writing, this
   software is distributed on an "AS IS" BASIS, WITHOUT WARRANTIES OR
   CONDITIONS OF ANY KIND, either express or implied.
*/
#include <stdio.h>
#include "freertos/FreeRTOS.h"
#include "freertos/task.h"
#include "sdkconfig.h"
#include "mbcontroller.h"

#define MB_PORT_NUM 2
#define MB_DEV_ADDR 1
#define MB_DEV_SPEED 115200

void app_main();

void vApplicationStackOverflowHook( TaskHandle_t xTask, signed char *pcTaskName )
{
	printf("Stack overflow.\n");
}

// An example application of modbus slave. It is based on freemodbus stack.
// See deviceparams.h file for more information about assigned modbus parameters.
// This file will contain all parameters and object dictionary generated by script.
// These parameters can be accessed from main application and also can be changed
// by external Modbus master host.
void app_main()
{
    tLookupRegisters* reg = NULL;

    mbcontroller_init();
    mbcontroller_setup(MB_RTU, MB_DEV_ADDR, MB_PORT_NUM, MB_DEV_SPEED, MB_PAR_NONE);

    for(;;){
        eMbEventGroup event = mbcontroller_check_event((MB_EVENT_HOLDING_REG_WR | MB_EVENT_INPUT_REG_RD));
        if(event & MB_EVENT_HOLDING_REG_WR)
        {
            // Holding registers change
            printf("MODBUS write holding registers event.\n");
        } else if (event & MB_EVENT_INPUT_REG_RD) {
            // Input registers change
            printf("MODBUS read input registers event.\n");
        }

        if(ESP_OK == mbcontroller_get_notification(&reg)){
            assert(reg != NULL);
            uint32_t test = 0x00001234;
            // Write serialNumber parameter by application
            mbcontroller_write_parameter(PARAM(serialNumber), &test); // Write static parameter
            printf("Main task notified about MODBUS parameter change: %s\n", (const char*)reg->parKey);
            printf("Parameter MODBUS address: %d\n", (uint32_t)(reg->offset));
            printf("Parameter type: %d\n", (uint32_t)(reg->type));
            printf("Parameter size: %d\n", (uint32_t)(reg->size));
        }
    }
}
