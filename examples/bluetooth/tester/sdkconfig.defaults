## examples/bluetooth/tester/sdkconfig.defaults
```kconfig
# Override some defaults so BT stack is enabled
# by default in this example
CONFIG_BT_ENABLED=y
CONFIG_BTDM_CONTROLLER_BLE_50_FEATURES_SUPPORTED=y
```

## examples/protocols/modbus_master/sdkconfig.defaults
```kconfig
#
# Modbus configuration
#
CONFIG_MB_SERIAL_MASTER_RTU_ENABLED=y
CONFIG_MB_SERIAL_MASTER_ASCII_ENABLED=
CONFIG_MB_SERIAL_SLAVE_RTU_ENABLED=
CONFIG_MB_SERIAL_SLAVE_ASCII_ENABLED=
CONFIG_MB_SERIAL_SLAVE_DISABLED=y
CONFIG_MB_UART_RXD=22
CONFIG_MB_UART_TXD=23
CONFIG_MB_UART_RTS=18
```

## examples/protocols/modbus_tcp/sdkconfig.defaults
```kconfig
#
# Modbus TCP configuration
#
CONFIG_ESP_WIFI_SSID="myssid"
CONFIG_ESP_WIFI_PASSWORD="mypassword"
CONFIG_MB_EXAMPLE_PORT=502
```
