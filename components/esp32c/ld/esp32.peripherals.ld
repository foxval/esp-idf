PROVIDE ( UART0 = 0x3f400000 );
PROVIDE ( SPI1 = 0x3f402000 );
PROVIDE ( SPI0 = 0x3f403000 );
PROVIDE ( GPIO = 0x3f404000 );
PROVIDE ( SIGMADELTA = 0x3f404f00 );
PROVIDE ( RTCCNTL = 0x3f408000 );
PROVIDE ( RTCIO = 0x3f408400 );
PROVIDE ( SENS = 0x3f408800 );
PROVIDE ( HINF = 0x3f40B000 );
PROVIDE ( UHCI1 = 0x3f40C000 );
PROVIDE ( I2S0 = 0x3f40F000 );
PROVIDE ( UART1 = 0x3f410000 );
PROVIDE ( I2C0 = 0x3f413000 );
PROVIDE ( UHCI0 = 0x3f414000 );
PROVIDE ( HOST = 0x3f415000 );
PROVIDE ( RMT = 0x3f416000 );
PROVIDE ( RMTMEM = 0x3f416800 );
PROVIDE ( PCNT = 0x3f417000 );
PROVIDE ( SLC = 0x3f418000 );
PROVIDE ( LEDC = 0x3f419000 );
PROVIDE ( MCPWM0 = 0x3f41E000 );
PROVIDE ( TIMERG0 = 0x3f41F000 );
PROVIDE ( TIMERG1 = 0x3f410000 );
PROVIDE ( SPI2 = 0x3f414000 );
PROVIDE ( SPI3 = 0x3f415000 );
PROVIDE ( SYSCON = 0x3f416000 );
PROVIDE ( I2C1 = 0x3f417000 );
PROVIDE ( SDMMC = 0x3f418000 );
PROVIDE ( MCPWM1 = 0x3f41C000 );
PROVIDE ( I2S1 = 0x3f41D000 );
PROVIDE ( UART2 = 0x3f41E000 );
